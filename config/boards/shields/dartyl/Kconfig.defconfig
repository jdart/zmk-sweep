## config/boards/shields/dartyl/Kconfig.defconfig
```kconfig
# Copyright (c) 2020 The ZMK Contributors
# SPDX-License-Identifier: MIT

if SHIELD_DARTYL_DONGLE

config ZMK_KEYBOARD_NAME
    default "Dartyl"

config ZMK_SPLIT_ROLE_CENTRAL
    default y

endif

if SHIELD_DARTYL_DONGLE || SHIELD_DARTYL_LEFT || SHIELD_DARTYL_RIGHT

config ZMK_SPLIT
    default y

endif
```

## config/boards/shields/dartyl/Kconfig.shield
```kconfig
# Copyright (c) 2020 The ZMK Contributors
# SPDX-License-Identifier: MIT

config SHIELD_DARTYL_DONGLE
	def_bool $(shields_list_contains,dartyl_dongle)

config SHIELD_DARTYL_LEFT
    def_bool $(shields_list_contains,dartyl_left)

config SHIELD_DARTYL_RIGHT
    def_bool $(shields_list_contains,dartyl_right)
```

## config/west.yml
```yaml
manifest:
  remotes:
    - name: zmkfirmware
      url-base: https://github.com/zmkfirmware
    - name: tri-state
      url-base: https://github.com/caksoylar
  projects:
    - name: zmk
      remote: tri-state
      revision: experimental
      import: app/west.yml
  self:
    path: config
```
